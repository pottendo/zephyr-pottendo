## CMakeLists.txt
```
# SPDX-License-Identifier: Apache-2.0

cmake_minimum_required(VERSION 3.20.0)
add_compile_options(-DPTHREADS -DMANDEL_PC=1 -DMANDEL_MQ)
find_package(Zephyr REQUIRED HINTS $ENV{ZEPHYR_BASE})
project(cpp)
target_sources(app PRIVATE /work/src/pottendo-mandel/mandel.cpp /work/src/pottendo-mandel/c64-lib.cpp)
```

## prj.conf
```kconfig
CONFIG_LOG=y
CONFIG_LOG_DEFAULT_LEVEL=3
CONFIG_CPP=y
CONFIG_GLIBCXX_LIBCPP=y
CONFIG_POSIX_API=y
CONFIG_MAX_PTHREAD_COUNT=72
CONFIG_MAX_PTHREAD_MUTEX_COUNT=255
CONFIG_TIMESLICING=y
CONFIG_TIMESLICE_SIZE=10
CONFIG_BOOT_BANNER=y
```

## src/main.cpp
```c
#include <iostream>
#include <unistd.h>
#include <pthread.h>
#include <cstring>
#include <math.h>
#include <vector>

#define NO_THREADS 16       // max 16 for Orangecart!
#define PIXELW 2 // 2
#define MAX_ITER 128
#define IMG_W 320 // 320
#define IMG_H 200 // 200
#define MTYPE double

#define CSIZE (IMG_W * IMG_H) / 8
#define PAL_SIZE (2 * PIXELW)

// set this to enable direct output on C64 gfx mem.
//#define C64

//#define NO_LOG
#ifdef NO_LOG
#define log_msg(...) 
#else
#define log_msg printf
#endif

#ifdef C64
#include "c64-lib.h"
#else
static char cv[CSIZE] = {};
//char *cv;
#endif

#define STACK_SIZE 1024
#ifdef CONFIG_BOARD_ORANGECART
#if (NO_THREADS > 16)
#error "too many threads for Orangencart's STACK_SIZE"
#endif
static char *stacks = (char *)0x10000000;   // fast SRAM on Orangecart, only 16k! so NO_THREADS <= 16
#else
static char *stacks;
#endif

#include "mandelbrot.h"
MTYPE xrat = 1.0;

typedef struct { point_t lu; point_t rd; } rec_t;
std::vector<rec_t> recs = { 
        {{00, 00},{80,100}}, 
        {{80, 100},{159,199}}, 
        {{00, 50},{40,100}},        
        {{80, 110}, {120, 160}},
        {{60,75}, {100, 125}},
        {{60,110}, {100, 160}},
        {{60,75}, {100, 125}},
        {{60,75}, {100, 125}},
        {{40,50}, {80, 100}},
        {{120,75}, {159, 125}},
    };

int main(void)
{
    log_msg("Welcome mandelbrot...\n");
#ifndef CONFIG_BOARD_ORANGECART
    stacks = (char *) alloca(STACK_SIZE * NO_THREADS); //new char[STACK_SIZE * NO_THREADS]();
    log_msg("%s: stack_size per thread = %d, no threads=%d\n", __FUNCTION__, STACK_SIZE, NO_THREADS);
#endif

#ifdef C64
    c64 c64;
    std::cout << "C64 memory @0x" << std::hex << int(c64.get_mem()) << std::dec << '\n';
    char *cv = (char *)&c64.get_mem()[0x4000];
    c64.screencols(VIC::BLACK, VIC::BLACK);
    c64.gfx(VICBank1, VICModeGfxMC, 15);
    //xrat = 16.0 / 9.0;
#endif
    int col1, col2, col3;
    col1 = 0xb;
    col2 = 0xc;
    col3 = 14; // VIC::LIGHT_BLUE;
    for (int i = 0; i < 16; i++) 
    {
#ifdef C64
            memset(&cv[0x3c00], (col1<<4)|col2, 1000);
            memset(&c64.get_mem()[0xd800], col3, 1000);
#endif 
        mandel<MTYPE> *m = new mandel<MTYPE>{cv, stacks, -1.5, -1.0, 0.5, 1.0, IMG_W / PIXELW, IMG_H, xrat};
        for (size_t i = 0; i < recs.size(); i++)
        {
            auto it = &recs[i];
            //log_msg("Zooming into [%d,%d]x[%d,%d]...stacks=%p\n", it->lu.x, it->lu.y, it->rd.x, it->rd.y, m->get_stacks());
            m->select_start(it->lu);
            m->select_end(it->rd);
            //sleep(2);
        }
        col1++; col2++; col3++;
        col1 %= 0xf; if (col1 == 0) col1++;
        col2 %= 0xf; if (col2 == 0) col2++;
        col3 %= 0xf; if (col3 == 0) col3++;
        delete m;
    }
#ifdef __ZEPHYR__
    while(1)
    {
        std::cout << "system halted.\n";
        sleep(10);
    }
#endif
    sleep(2);
    return 0;
}
```

## src/c64-lib.cpp
```c
// -*-c++-*-
// $Id$
//
// File:		c64-linux.c
// Date:		Fri Dec 16 09:38:08 2022
// Author:		pottendo (pottendo)
// 
// Abstract:
//      
//
// Modifications:
// 	$Log$
//
#include <stdio.h>
#ifndef __ZEPHYR__
#include <fcntl.h>
#include <sys/mman.h>
#endif

#include "mandel-arch.h"

#include <unistd.h>
#include <iostream>
#include <cstring>
#include "c64-lib.h"

c64_t::c64_t()
{
    mem = vic = cia1 = cia2 = sid = oc_ctrl = nullptr;
    mem = map_memory(c64_physaddress, 0x10000);
    if (mem == (unsigned char*) -1)
	    perror("map_memory failed.");
    else
    {
	    vic = &mem[0xd000];
	    cia1 = &mem[0xdc00];
	    cia2 = &mem[0xdd00];
	    sid = &mem[0xd400];
	    oc_ctrl = &mem[0xdf00];
    }
}

c64_t::~c64_t()
{
    gfx(VICBank0, VICModeText, 1);
#ifndef __ZEPHYR__
    munmap(mem, 0x10000);
#endif    
}

void c64_t::gfx(c64_consts bank, c64_consts mode, uint8_t vram)
{
    if (!vic)
    {
	log_msg("vic not mapped.\n");
	return;
    }
    cia2[0] &= 0b11111100;
    cia2[0] |= bank;
    switch(mode)
    {
    case VICModeGfxMC:
	vic[VIC::CR2] |= 0b00010000;
    case VICModeGfxHR:
	vic[VIC::CR1] |= 0b00100000;
	if (vram > 15)
	    log_msg("%s: illegal VRAM: 0x%02x\n", __FUNCTION__, vram);
	vic[VIC::MEM] &= 0b00001111;
	vic[VIC::MEM] |= (vram << 4);
	break;
    case VICModeText:
	vic[VIC::CR1] &= 0b11011111;
	vic[VIC::CR2] &= 0b11101111;
	if (vram > 15)
	    log_msg("%s: illegal VRAM: 0x%02x\n", __FUNCTION__, vram);
	vic[VIC::MEM] &= 0b00001111;
	vic[VIC::MEM] |= (vram << 4);
	break;
    default:
	log_msg("%s: unkown VIC mode %d.\n", __FUNCTION__, mode);
	break;
    }
}

unsigned char *
c64_t::map_memory(off_t offset, size_t len)
{
#ifndef __ZEPHYR__
    // Truncate offset to a multiple of the page size, or mmap will fail.
    size_t pagesize = sysconf(_SC_PAGE_SIZE);
    off_t page_base = (offset / pagesize) * pagesize;
    off_t page_offset = offset - page_base;

    int fd = open("/dev/mem", (O_RDWR | O_DSYNC));
    unsigned char *mem = (unsigned char *) mmap(NULL, page_offset + len, PROT_READ | PROT_WRITE,
						MAP_SHARED, fd, page_base);
    if (mem == MAP_FAILED) {
        perror("Can't map memory");
        return (unsigned char *)-1;
    }
#else
    mem = (unsigned char *)offset;
#endif    
    return mem;
}

/* globals */
c64_t c64;
int col1, col2, col3;
char *c64_stack = (char *)0x10000000; // fast SRAM on Orangecart, only 16k! so NO_THREADS <= 16;

void c64_screen_init(void)
{
    std::cout << "C64 memory @0x" << std::hex << int(c64.get_mem()) << std::dec << '\n';
    c64.screencols(VIC::BLACK, VIC::BLACK);
    c64.gfx(VICBank1, VICModeGfxMC, 15);
    // xrat = 16.0 / 9.0;
    col1 = 0xb;
    col2 = 0xc;
    col3 = 14; // VIC::LIGHT_BLUE;
}

void c64_hook1(void)
{
        memset(&c64.get_mem()[0x3c00], (col1 << 4) | col2, 1000);
        memset(&c64.get_mem()[0xd800], col3, 1000);
}

void c64_hook2(void)
{
        col1++; col2++; col3++;
        col1 %= 0xf;
        if (col1 == 0)
            col1++;
        col2 %= 0xf;
        if (col2 == 0)
            col2++;
        col3 %= 0xf;
        if (col3 == 0)
            col3++;
}
```

## src/c64-lib.h
```c
/*  -*-c-*-
 * File:		c64-lib.h
 * Date:		Fri Dec 16 09:39:01 2022
 * Author:		pottendo (pottendo)
 *  
 * Abstract:
 *     some aux functions for c64 @linux orange cart
 * 
 * Modifications:
 * $Log$
 */

#ifndef __c64_linux_h__
#define __c64_linux_h__
#include <stdint.h>

typedef enum {
    VICBank0 = 3, VICBank1 = 2, VICBank2 = 1, VICBank3 = 0,
    VICModeGfxHR = 4, VICModeGfxMC = 5, VICModeText = 6
} c64_consts;

namespace VIC
{
    const uint8_t BoC = 0x20;
    const uint8_t BgC = 0x21;
    const uint8_t CR1 = 0x11;
    const uint8_t CR2 = 0x16;
    const uint8_t MEM = 0x18;
    enum { BLACK = 0, WHITE, RED, CYAN, PURPLE, GREEN, BLUE, YELLOW,
	   ORANGE, BROWN, PINK, DARK_GREY, GREY, LIGHT_GREEN, LIGHT_BLUE, LIGHT_GREY };
};

class c64_t
{
#ifdef CONFIG_BOARD_ORANGECART_VexRV32 // Fixme: should be done via DTS query
    const uint32_t c64_physaddress = 0x00000000;  // as defined in basesoc.py, RVCop64 
    typedef uint32_t off_t;
#elif defined(CONFIG_BOARD_ORANGECART_VexRV32SMP_FPU) || defined (CONFIG_BOARD_ORANGECART_VexRV32SMP_SMP) || defined (CONFIG_BOARD_ORANGECART_VexRV32SMP_IMA)
    const uint32_t c64_physaddress = 0x0f000000;  // as defined in basesoc.py, RVCop64
    typedef uint32_t off_t;
#endif    
    
    unsigned char *map_memory(off_t addr, size_t len);
    unsigned char *mem, *vic, *cia1, *cia2, *sid, *oc_ctrl;

  public:
    c64_t();
    ~c64_t();

    unsigned char *get_mem(void) { return mem; }
    void gfx(c64_consts bank, c64_consts mode, uint8_t vram);
    void screencols(uint8_t bo, uint8_t bg) { vic[VIC::BoC] = bo; vic[VIC::BgC] = bg; }

};

extern void c64_hook1(void);
extern void c64_hook2(void);
#endif /* __c64_linux_h__ */
```

## src/mandel-arch.h
```c
#ifndef __MANDEL_ARCH_H__
#define __MANDEL_ARCH_H__
/* definition section for globals to adapt for some variation */
#define MTYPE double //long long int  // double
//#define INTMATH              // goes along with int above, on Intels or other fast FPUs, double/float can be faster
#define MAX_ITER_INIT 64
//#define C64   // build for C64 GFX output

// some global internals, no need to change normally
#ifdef INTMATH
#define INTSCALE 102400000LL
#define INTIFY(a) ((a) * INTSCALE)
#define INTIFY2(a) ((a) * INTSCALE * INTSCALE)
#define DEINTIFY(a) ((a) / INTSCALE)
#else
#define INTIFY(a) (a)
#define INTIFY2(a) (a)
#define DEINTIFY(a) (a)
#endif
#define alloc_stack new char[STACK_SIZE * NO_THREADS]()
#define alloc_canvas new char[CSIZE]()

void log_msg(const char *s, ...);
//#define NO_LOG
#ifdef NO_LOG
#define log_msg(...)
#endif

#ifdef PTHREADS
#include <stdio.h>
#include <time.h>
#include <pthread.h>
#define NO_THREADS 16 // max 16 for Orangecart!
#ifdef PTHREAD_STACK_MIN
#define STACK_SIZE PTHREAD_STACK_MIN
#else
#define STACK_SIZE 1024
#endif
extern pthread_mutex_t logmutex;
#else
#define NO_THREADS 1 // singlethreaded
#define log_msg printf
#define STACK_SIZE 1024
#endif
#define MAX_ITER iter   // relict

#ifdef __amiga__
#include <proto/exec.h>
#include <proto/dos.h>
#include <exec/io.h>
#include <inline/timer.h>
#include <proto/intuition.h>
#include <proto/graphics.h>
#include <graphics/sprite.h>
#include <exec/memory.h>
#include <devices/inputevent.h>
#include <clib/console_protos.h>
#include <vector>

#define SCRDEPTH 4  // or 6 for 64cols lesser resolution
#define PAL_SIZE (1L << SCRDEPTH)
#define PIXELW 1

#if (SCRDEPTH > 6)
#error "pixeldepth too large, must be <= 6"
#endif
#if (SCRDEPTH <= 4)
#define HALF 1
//#define HALF 2
#define SCRMODE (HIRES|LACE)
//#define SCRMODE EXTRA_HALFBRITE
#define SCMOUSE 2
//#define SCMOUSE 1
#else
#define HALF 2
#define SCRMODE (EXTRA_HALFBRITE)
#define SCMOUSE 1
#endif

#define IMG_W (640 / HALF)      // 320
#define IMG_H (512 / HALF - 20) // 200
#define CSIZE (IMG_W * IMG_H) / 8
#define WINX (IMG_W / 1)
#define WINY (IMG_H / 1)

extern int iter;
#include "mandelbrot.h"
void amiga_setup_screen(void);
void amiga_zoom_ui(mandel<MTYPE> *m);

#define setup_screen amiga_setup_screen
#define zoom_ui amiga_zoom_ui
#define hook1(...)
#define hook2(...)

#else  /* __amiga__ */

#ifdef LUCKFOX
#define IMG_W img_w
#define IMG_H img_h
#define SCRDEPTH 16  // or 6 for 64cols lesser resolution
#define PAL_SIZE (1L << SCRDEPTH)
#define PIXELW 1
#define CSIZE (img_w * img_h) / 8

#ifndef PTHREAD_STACK_MIN
#undef STACK_SIZE
#define STACK_SIZE 16384
#endif

#include <stdint.h>

extern uint16_t *tft_canvas;		// must not be static?!

void luckfox_setpx(void *canvas, int x, int y, uint16_t c);
void init_luckfox(void);
void luckfox_palette(uint16_t *p);
void luckfox_play(void);
void luckfox_rect(int x1, int y1, int x2, int y2, uint16_t c);

#define zoom_ui(...) luckfox_play()
#define setup_screen init_luckfox
#define canvas_setpx luckfox_setpx
#define hook1(...)
#define hook2(...)

#else 
#if defined(C64) || defined (__ZEPHYR__)
#if (NO_THREADS > 16)
#error "too many threads for Orangencart's STACK_SIZE"
#endif
#define IMG_W 160
#define IMG_H 200
#define SCRDEPTH 2
#define CSIZE ((IMG_W/8) * IMG_H)
#define PAL_SIZE (1L << SCRDEPTH)
#define PIXELW 2 // 2
#undef STACK_SIZE
#define STACK_SIZE 1024
#define canvas_setpx canvas_setpx_
#define setup_screen(...)
#define zoom_ui(...)

#include "c64-lib.h"
extern c64_t c64;
extern char *c64_stack;
#undef alloc_stack
#define alloc_stack c64_stack
#ifdef C64
#undef alloc_canvas
#define alloc_canvas (char *)&c64.get_mem()[0x4000]
#define hook1 c64_hook1
#define hook2 c64_hook2
#else
#define hook1(...)
#define hook2(...)
#endif

#else // non-specific architectures 
#define IMG_W 256
#define IMG_H 120
#define SCRDEPTH 2
#define CSIZE ((IMG_W/8) * IMG_H)
#define PAL_SIZE (1L << SCRDEPTH)
#define PIXELW 2 // 2

#define canvas_setpx canvas_setpx_
#define setup_screen(...)
#define zoom_ui(...)
#define hook1(...)
#define hook2(...)

#endif /* C64 || __ZEPHYR__ */
#endif /* LUCKFOX */
#endif /* __amiga__ */
#endif /* __MANDEL_ARCH_H__*/
```

## src/mandel.cpp
```c
#include <stdarg.h>
#include <cstring>
#include <math.h>
#include <vector>

#include "mandel-arch.h"

#ifdef PTHREADS
pthread_mutex_t canvas_sem;
pthread_mutex_t logmutex;
void log_msg(const char *s, ...)
{
    char t[256];
    va_list args;
    pthread_mutex_lock(&logmutex);
    va_start(args, s);
    vsnprintf(t, 256, s, args);
    printf(t);
    pthread_mutex_unlock(&logmutex);
}
#endif  /* PTHREADS */

// globals
int img_w, img_h;   // used by luckfox
int iter = MAX_ITER_INIT;  // used by Amiga
MTYPE xrat = 1.0;

static char *cv;
static char *stacks;

#include "mandelbrot.h"

typedef struct
{
    point_t lu;
    point_t rd;
} rec_t;

int main(void)
{
    pthread_mutex_init(&logmutex, NULL);
    log_msg("Welcome mandelbrot...\n");
    stacks = alloc_stack;
    setup_screen();
    cv = alloc_canvas;
    log_msg("%s: stack_size per thread = %d, no threads=%d, iter = %d, palette = %ld, stacks = %p, cv = %p, CSIZE = %d\n", 
        __FUNCTION__, STACK_SIZE, NO_THREADS, iter, PAL_SIZE, stacks, cv, CSIZE);
#if 0
std::vector<rec_t> recs = { 
        {{00, 00},{80,100}}, 
        {{80, 100},{159,199}}, 
        {{00, 50},{40,100}},        
        {{80, 110}, {120, 160}},
        {{60,75}, {100, 125}},
        {{60,110}, {100, 160}},
        {{60,75}, {100, 125}},
        {{60,75}, {100, 125}},
        {{40,50}, {80, 100}},
        {{120,75}, {159, 125}},
    };
#else
std::vector<rec_t> recs = {
    {{00, IMG_H / 4}, {IMG_W / 2, IMG_H / 4 * 3}},
    {{00, IMG_H / 4}, {IMG_W / 2, IMG_H / 4 * 3}},
    {{IMG_W / 4, IMG_H / 4}, {IMG_W / 4 + 200, IMG_H / 4 * 3}},
};
#endif

    for (int i = 0; i < 1; i++)
    {
        hook1();
        mandel<MTYPE> *m = new mandel<MTYPE>{cv, stacks, 
                                            static_cast<MTYPE>(INTIFY(-1.5)), static_cast<MTYPE>(INTIFY(-1.0)), 
                                            static_cast<MTYPE>(INTIFY(0.5)), static_cast<MTYPE>(INTIFY(1.0)), 
                                            IMG_W / PIXELW, IMG_H, xrat};
        zoom_ui(m);
        //return 0;
        for (size_t i = 0; i < recs.size(); i++)
        {
            auto it = &recs[i];
            log_msg("%d/%d, zooming into [%d,%d]x[%d,%d]...stacks=%p\n", (int)i, (int)recs.size(), it->lu.x, it->lu.y, it->rd.x, it->rd.y, m->get_stacks());
            m->select_start(it->lu);
            m->select_end(it->rd);
        }
        delete m;
        hook2();
    }
#ifndef C64
    delete cv;
    delete stacks;
#endif
    return 0;
}
```

## src/mandelbrot.h
```c
/* -*-c++-*-
 * This file is part of pottendos-playground.
 *
 * FE playground is free software: you can redistribute it and/or modify
 * it under the terms of the GNU General Public License as published by
 * the Free Software Foundation, either version 3 of the License, or
 * (at your option) any later version.
 *
 * FE playground is distributed in the hope that it will be useful,
 * but WITHOUT ANY WARRANTY; without even the implied warranty of
 * MERCHANTABILITY or FITNESS FOR A PARTICULAR PURPOSE.  See the
 * GNU General Public License for more details.
 *
 * You should have received a copy of the GNU General Public License
 * along with FE playground.  If not, see <https://www.gnu.org/licenses/>.
 *
 */

#ifndef __MANDELBROT_H__
#define __MANDELBROT_H__

#include <stdlib.h>
#include <unistd.h>
#include <complex>
// #include <iostream>
#include <signal.h>

#include <time.h>
#include <cstdint>
typedef struct
{
    int x;
    int y;
} point_t;

#ifdef PTHREADS
#include <pthread.h>
#include <semaphore.h>
extern pthread_mutex_t canvas_sem;
#define P P_
#define V V_
#else
// make those calls dummies
#define pthread_mutex_init(...)
#define pthread_mutex_destroy(...)
#define pthread_mutex_lock(...)
#define pthread_mutex_unlock(...)
#define sem_wait(...)
#define sem_post(...)
#define sem_init(...)
#define sem_destroy(...)
#define pthread_getschedparam(...)
#define pthread_attr_setschedpolicy(...)
#define pthread_attr_init(...)
#define pthread_attr_destroy(...) 0
#define pthread_attr_setstack(...) 0
#define pthread_create(...) 0
#define pthread_detach(...) 0
#define pthread_exit(...)
#define sem_t int
#define pthread_t int
#define pthread_mutex_t int
#define sched_yield(...)
#define P(...)
#define V(...)
#endif /* PTHREADS */


template <typename myDOUBLE>
class mandel
{
    typedef char *canvas_t;
    typedef uint16_t coord_t;
    typedef uint16_t color_t;
    struct tparam_t
    {
        int tno, width, height;
        myDOUBLE xl, yl, xh, yh, incx, incy;
        int xoffset, yoffset;
        pthread_mutex_t go;
        sem_t &sem;
        mandel<myDOUBLE> *mo;

        tparam_t(int t, int w, int h, myDOUBLE x1, myDOUBLE y1, myDOUBLE x2, myDOUBLE y2, myDOUBLE ix, myDOUBLE iy,
                 int xo, int yo, sem_t &se, mandel<myDOUBLE> *th)
            : tno(t), width(w), height(h), xl(x1), yl(y1), xh(x2), yh(y2), incx(ix), incy(iy), xoffset(xo), yoffset(yo), sem(se), mo(th)
        {
            pthread_mutex_init(&go, nullptr);
            P(go); // lock it
            // std::cout << *this << '\n';
        }
        ~tparam_t()
        {
            // log_msg("cleaning up params\n");
            pthread_mutex_destroy(&go);
        }
        friend std::ostream &operator<<(std::ostream &ostr, tparam_t &t)
        {
            ostr << "t=" << t.tno << ", w=" << t.width << ",h=" << t.height
                 << ",xl=" << t.xl << ",yl=" << t.yl << ",xh=" << t.xh << ",yh=" << t.yh
                 << ",incx=" << t.incx << ",incy=" << t.incy
                 << ",xo=" << t.xoffset << ",yo=" << t.yoffset << ", go: " << t.go;
            return ostr;
        }
    };

    tparam_t *tp[NO_THREADS];
    // char *stacks[NO_THREADS];
    int &max_iter = MAX_ITER;
    uint8_t _mask;

    /* class local variables */
#ifdef PTHREADS
    pthread_attr_t attr[NO_THREADS];
#endif
    pthread_t worker_tasks[NO_THREADS];
    sem_t master_sem;

    canvas_t canvas;
    char *stacks;
    int xres, yres;
    color_t col_pal[PAL_SIZE];// = {0, 1, 2, 3};
    coord_t mark_x1, mark_y1, mark_x2, mark_y2;
    myDOUBLE last_xr, last_yr, ssw, ssh, transx, transy, xratio;
    int stop;
    struct timespec tstart, tend;

    static void P_(pthread_mutex_t &m)
    {
        pthread_mutex_lock(&m);
    }
    static void V_(pthread_mutex_t &m)
    {
        pthread_mutex_unlock(&m);
    }
    static void PSem(sem_t &s)
    {
        sem_wait(&s);
    }
    static void VSem(sem_t &s)
    {
        sem_post(&s);
    }

    void canvas_setpx_(canvas_t &canvas, coord_t x, coord_t y, color_t c)
    {
        uint32_t h = x % (8 / PIXELW);
        uint32_t shift = (8 / PIXELW - 1) - h;
        uint32_t val = (c << (shift * PIXELW));
        uint8_t mask = ~(_mask << (shift * PIXELW));
        const uint32_t lineb = IMG_W / 8 * 8; // line 8 bytes per 8x8 pixel
        const uint32_t colb = 8;              // 8 bytes per 8x8 pixel

        // log_msg("x/y %d/%d offs %d/%d\n", x, y, (x / (8 / PIXELW)) * colb, (y / 8) * lineb  + (y % 8));
        uint32_t cidx = (y / 8) * lineb + (y % 8) + (x / (8 / PIXELW)) * colb;
        if (cidx >= (uint32_t)CSIZE)
        {
            // log_msg("Exceeding canvas!! %d, %d/%d\n", cidx, x, y);
            // delay (100 * 1000);
            return;
        }
        char t = canvas[cidx];
        t &= mask;
        t |= val;
        canvas[cidx] = t;
#ifdef __ZEPHYR__
        // volatile char *led= (char *)0xf0002000;
        //*led = ((*led) + 1);
#endif
        // sched_yield();
    }

    void dump_bits(uint8_t c)
    {
        for (int i = 7; i >= 0; i--)
        {
            log_msg("%c", (c & (1 << i)) ? '*' : '.');
        }
    }

    void canvas_dump(canvas_t c)
    {
        for (int y = 0; y < IMG_H; y++)
        {
            log_msg("%03d: ", y);
            int offs = (y / 8) * IMG_W + (y % 8);
            for (auto i = 0; i < IMG_W / 1; i += 8)
            {
                // log_msg("idx: %032d ", offs + i);
                dump_bits(c[offs + i]);
            }
            log_msg("\n");
        }
    }

    /* class private functinos */
    inline void timespec_diff(struct timespec *a, struct timespec *b, struct timespec *result)
    {
        result->tv_sec = a->tv_sec - b->tv_sec;
        result->tv_nsec = a->tv_nsec - b->tv_nsec;
        if (result->tv_nsec < 0)
        {
            --result->tv_sec;
            result->tv_nsec += 1000000000L;
        }
    }

    // abs() would calc sqr() as well, we don't need that for this fractal
    inline myDOUBLE abs2(std::complex<myDOUBLE> f)
    {
        myDOUBLE r = f.real(), i = f.imag();
        return r * r + i * i;
    }

    int mandel_calc_point(myDOUBLE x, myDOUBLE y)
    {
        const std::complex<myDOUBLE> point{x, y};
        // std::cout << "calc: " << point << '\n';
        std::complex<myDOUBLE> z = point;
        int nb_iter = 1;
        while (abs2(z) < INTIFY2(4) && nb_iter <= max_iter)
        {
            z = (DEINTIFY(z * z) + point);
            nb_iter++;
        }
        if (nb_iter < max_iter)
            return (col_pal[(nb_iter % (PAL_SIZE - 1)) + 1]);
        else
            return 0;
    }

    void mandel_helper(myDOUBLE xl, myDOUBLE yl, myDOUBLE xh, myDOUBLE yh, myDOUBLE incx, myDOUBLE incy, int xo, int yo, int width, int height)
    {
        myDOUBLE x, y;
        int xk = xo;
        int yk = yo;
        if ((xl == xh) || (yl == yh))
        {
            //log_msg("assertion failed: xl=%d, xh=%d, yl=%d, yh=%d\n", xl, xh, yl, yh);
            log_msg("assertion failed - reached fixp/fpu limit!\n");
            return;
        }
        x = xl;
        for (xk = 0; xk < width; xk++)
        {
            y = yl;
            for (yk = 0; yk < height; yk++)
            {
                int d = mandel_calc_point(x, y);
                P(canvas_sem);
#ifdef __amiga__
                int amiga_setpixel(void *, int x, int y, int col);
                if (stop || (stop = amiga_setpixel(NULL, xk + xo, yk + yo, d)))
                {
                    V(canvas_sem);
                    goto out;
                }
#else
                canvas_setpx(canvas, xk + xo, yk + yo, d);
#endif
                V(canvas_sem);
                y += incy;
            }
            x += incx;
        }
#ifdef __amiga__	
        out:
        ;
#endif	
    }

    static void *mandel_wrapper(void *param)
    {
        tparam_t *p = static_cast<tparam_t *>(param);
        p->mo->mandel_wrapper_2(param);
        pthread_exit(nullptr);
        return nullptr;
    }

    int mandel_wrapper_2(void *param)
    {
        tparam_t *p = (tparam_t *)param;

#if defined(__ZEPHYR__) && defined(CONFIG_FPU)
        // make sure FPU regs are saved during context switch
        int r;
        if ((r = k_float_enable(k_current_get(), 0)) != 0)
        {
            log_msg("%s: k_float_enable() failed: %d.\n", __FUNCTION__, r);
        }
#endif
        P(p->go);
#ifdef PTHREADS
#ifdef __linux__
        sched_param sp;
        int pol = -1;
        int ret;
        ret = pthread_getschedparam(worker_tasks[p->tno], &pol, &sp);
        if (ret != 0)
            log_msg("ptherad_getschedparam()... failed: %d\n", ret);
        sp.sched_priority = sp.sched_priority + (p->tno % 3) + 1;
        if ((ret = pthread_setschedparam(worker_tasks[p->tno], SCHED_RR, &sp)) != 0)
            log_msg("pthread setschedparam (pol=%d) failed for thread %d, %d - need sudo!\n", SCHED_RR, p->tno, ret);
        pthread_getschedparam(worker_tasks[p->tno], &pol, &sp);
        log_msg("starting thread %d with priority %d\n", p->tno, sp.sched_priority);
#endif
#endif
        sched_yield();
        mandel_helper(p->xl, p->yl, p->xh, p->yh, p->incx, p->incy, p->xoffset, p->yoffset, p->width, p->height);
        //log_msg("finished thread %d\n", p->tno);
        VSem(p->sem); // report we've done our job
        return 0;
    }


    void mandel_setup(const int thread_no, myDOUBLE sx, myDOUBLE sy, myDOUBLE tx, myDOUBLE ty)
    {
        int t = 0;
        mandel_presetup(sx, sy, tx, ty);
        myDOUBLE stepx = (xres / thread_no) * ssw * xratio;
        myDOUBLE stepy = (yres / thread_no) * ssh;
        pthread_t th = (pthread_t)0;

        if (thread_no > 16)
        {
            if (thread_no != 100) /* 100 is a dummy to just initialize, don't confuse us with this log */
                log_msg("%s: too many threads(%d)... giving up.\n", __FUNCTION__, thread_no);
            return;
        }
        int w = (xres / thread_no);
        int h = (yres / thread_no);

        for (int tx = 0; tx < thread_no; tx++)
        {
            int xoffset = w * tx;
            for (int ty = 0; ty < thread_no; ty++)
            {
                int ret;
                int yoffset = h * ty;
                tp[t] = new tparam_t(t,
                                     w, h,
                                     tx * stepx + transx,
                                     ty * stepy + transy,
                                     tx * stepx + stepx + transx,
                                     ty * stepy + stepy + transy,
                                     ssw, ssh, xoffset, yoffset,
                                     master_sem, this);
                pthread_attr_init(&attr[t]);
                ret = pthread_attr_setstack(&attr[t], stacks + t * STACK_SIZE, STACK_SIZE);
                if (ret != 0)
                    log_msg("setstack: %d - ssize = %d\n", ret, STACK_SIZE);
                if ((ret = pthread_create(&th, &attr[t], mandel_wrapper, tp[t])) != 0)
                    log_msg("pthread create failed for thread %d, %d\n", t, ret);
                worker_tasks[t] = th;
#ifndef PTHREADS
                if (clock_gettime(CLOCK_REALTIME, &tstart) < 0)
                    perror("clock_gettime()");
                //log_msg("start at %ld.%06ld\n", tstart.tv_sec % 60, tstart.tv_nsec / 1000);
                mandel_wrapper(tp[t]);
#endif
#ifdef __linux__
                ret = pthread_detach(th);
                if (ret != 0)
                    log_msg("pthread detach failed for thread %d, %d\n", t, ret);
#endif
#if (CONFIG_LOG_DEFAULT_LEVEL > 3)
                usleep(20 * 1000); // needed to make zephyr happy when loggin is enabled. Seems some race with the the KickOff mutex. Maybe some bug?
#endif
                t++;
            }
        }
    }

    void go(void)
    {
#ifdef PTHREADS
        memset(canvas, 0, CSIZE);
        if (clock_gettime(CLOCK_REALTIME, &tstart) < 0)
            perror("clock_gettime()");
            // log_msg("start at %ld.%06ld\n", tstart.tv_sec % 60, tstart.tv_nsec / 1000);
#endif
        for (int i = 0; i < NO_THREADS; i++)
        {
            // usleep(250 * 1000);
            V(tp[i]->go);
        }
        // log_msg("main thread waiting for %i threads...\n", NO_THREADS);
        for (int i = NO_THREADS; i; i--)
        {
            // log_msg("main thread waiting for %i threads...\n", i);
            PSem(master_sem); // wait until all workers have finished
        }

        if (clock_gettime(CLOCK_REALTIME, &tend) < 0)
            perror("clock_gettime()");
        //log_msg("end at %ld.%06ld\n", tend.tv_sec % 60, tend.tv_nsec / 1000);

        //log_msg("all threads finished.\n");
        free_ressources();
        stop = 0;
    }

    void free_ressources(void)
    {
        for (int i = 0; i < NO_THREADS; i++)
        {
            int ret;
#ifdef __ZEPHYR__
            // in recent Zephyr not needed enymore - even crashes soon!
            // needed to cleanup all resources, namely a mutex within a pthread
            // void *retval;
            // if ((ret = pthread_join(worker_tasks[i], &retval)) != 0)
            //    log_msg("pthread_join failed: %d\n", ret);
#endif
            if ((ret = pthread_attr_destroy(&attr[i])) != 0)
                log_msg("pthread_attr_destroy failed: %d\n", ret);

            delete tp[i];
        }
    }

public:
    mandel(canvas_t c, char *st, myDOUBLE xl, myDOUBLE yl, myDOUBLE xh, myDOUBLE yh, int xr, int yr, myDOUBLE xrat = 1.0)
        : canvas(c), stacks(st), xres(xr), yres(yr), xratio(xrat), stop(0)
    {
#ifdef LUCKFOX
	luckfox_palette(col_pal);
	int c1 = 0;
	for (int i = 0; i < 320; i += 2, c1++)
	    luckfox_rect(i, 0, i+1, 240, col_pal[c1]);
#else	
        for (int i = 0; i < PAL_SIZE; i++)
            col_pal[i] = i;
#endif	
        _mask = 1;
        for (int i = 1; i < PIXELW; i++)
        {
            _mask = (_mask << 1) | 1;
        }

        pthread_mutex_init(&canvas_sem, nullptr);
        sem_init(&master_sem, 0, 0);
#if 0	
        log_msg("hit enter to start...\n");
        char c1;
        read(0, &c1, 1);
#endif
        mandel_setup(sqrt(NO_THREADS), xl, yl, xh, yh); // initialize some stuff, but don't calculate
        go();
        dump_result();
    }
    ~mandel()
    {
        //log_msg("%s destructor\n", __FUNCTION__);
        pthread_mutex_destroy(&canvas_sem);
        sem_destroy(&master_sem);
    };

    char *get_stacks(void) { return stacks; }

    void dump_result(void)
    {
#if !defined(C64) && !defined(LUCKFOX) && !defined(__amiga__)
        canvas_dump(canvas);
#endif
        struct timespec dt;
        timespec_diff(&tend, &tstart, &dt);
        log_msg("mandelbrot set done in: %lld.%06lds\n", (long long int)dt.tv_sec, dt.tv_nsec / 1000L);
    }

    void select_start(point_t &p)
    {
        mark_x1 = p.x; // - ((LV_HOR_RES_MAX - IMG_W) / 2);
        mark_y1 = p.y; // - ((LV_VER_RES_MAX - IMG_H) / 2);
        if (mark_x1 < 0)
            mark_x1 = 0;
        if (mark_y1 < 0)
            mark_y1 = 0;
    }

    void select_end(point_t &p)
    {
        mark_x2 = p.x; // - ((LV_HOR_RES_MAX - IMG_W) / 2);
        mark_y2 = p.y; // - ((LV_VER_RES_MAX - IMG_H) / 2);
        if (mark_x2 < 0)
            mark_x2 = 0;
        if (mark_y2 < 0)
            mark_y2 = 0;
        //log_msg("rect coord: [%d,%d]x[%d,%d] - ssw=%d,ssh=%d,trx=%d,try=%d\n", mark_x1, mark_y1, mark_x2, mark_y2, ssw, ssh, transx, transy);
        log_msg("rect coord: [%d,%d]x[%d,%d]\n", mark_x1, mark_y1, mark_x2, mark_y2);
        mandel_setup(sqrt(NO_THREADS),
                     static_cast<myDOUBLE>(mark_x1 * ssw + transx),
                     static_cast<myDOUBLE>(mark_y1 * ssh + transy),
                     static_cast<myDOUBLE>(mark_x2 * ssw + transx),
                     static_cast<myDOUBLE>(mark_y2 * ssh + transy));
        go();
        dump_result();
        mark_x1 = -1;
        mark_x2 = mark_x1;
        mark_y2 = mark_y1;
    }

    void mandel_presetup(myDOUBLE sx, myDOUBLE sy, myDOUBLE tx, myDOUBLE ty)
    {
        last_xr = (tx - sx);
        last_yr = (ty - sy);
        ssw = last_xr / xres;
        ssh = last_yr / yres;
        transx = sx;
        transy = sy;
    }
#if 0
    void select_update(point_t &p)
    {
        if (mark_x1 < 0)
            return;
        coord_t tx = mark_x2;
        coord_t ty = mark_y2;
        mark_x2 = p.x; // - ((LV_HOR_RES_MAX - IMG_W) / 2);
        mark_y2 = p.y; // - ((LV_VER_RES_MAX - IMG_H) / 2);
        if (mark_x2 < 0)
            mark_x2 = 0;
        if (mark_y2 < 0)
            mark_y2 = 0;
        if ((tx == mark_x2) && (ty == mark_y2))
            return;
        //log_msg("rect coord: %dx%d - %dx%d\n", mark_x1, mark_y1, mark_x2, mark_y2);
    }
#endif
};

#endif
```
