## boards/pottendo/orangecart/Kconfig.defconfig
```kconfig
# Copyright (c) 2023 pottendo
# SPDX-License-Identifier: Apache-2.0

############################################## RVCop64 original
if BOARD_ORANGECART_VexRV32

config BOARD
	default "orangecart_VexRV32"

config ARCH_HAS_GDBSTUB
    default n

config SPI
	default y

config DISK_DRIVER_SDMMC
        default y if DISK_DRIVERS

config C64_MEMBASE
	hex "memory address, where bitstream maps the C64 64k"
	default 0x00000000

endif # BOARD_ORANGECART_VexRV32

############################################## FPU
if BOARD_ORANGECART_VexRV32SMP_FPU
config BOARD
        default "orangecart_VexRV32SMP_fpu"

config SPI
        default y

config FPU
    bool "Support floating point operations"
        default y

config DISK_DRIVER_SDMMC
        default y if DISK_DRIVERS

config C64_MEMBASE
        hex "memory address, where bitstream maps the C64 64k"
        default 0x0f000000

config RISCV_HAS_PLIC
        default y
        
endif # BOARD_ORANGECART_VexRV32SMP_FPU

############################################## SMP
if BOARD_ORANGECART_VexRV32SMP_SMP
config BOARD
        default "orangecart_VexRV32SMP_smp"

config SPI
        default y

config FPU
    bool "Support floating point operations"
        default n

config DISK_DRIVER_SDMMC
        default y if DISK_DRIVERS

config C64_MEMBASE
        hex "memory address, where bitstream maps the C64 64k"
        default 0x0f000000

config RISCV_HAS_PLIC
        default y
        
endif # BOARD_ORANGECART_VexRV32SMP_SMP

############################################## SC, no FPU vexriscv_smp cpu
if BOARD_ORANGECART_VexRV32SMP_IMA
config BOARD
        default "orangecart_VexRV32SMP_ima"

config SPI
        default y

config FPU
    bool "Support floating point operations"
        default n

config DISK_DRIVER_SDMMC
        default y if DISK_DRIVERS

config C64_MEMBASE
        hex "memory address, where bitstream maps the C64 64k"
        default 0x0f000000

config RISCV_HAS_PLIC
        default y
        
endif # BOARD_ORANGECART_VexRV32SMP_IMA
```

## boards/pottendo/orangecart/Kconfig.orangecart
```kconfig
# Copyright (c) 2022-2023 pottendo
# SPDX-License-Identifier: Apache-2.0

config BOARD_ORANGECART_VexRV32
	bool "Board with LiteX/VexRiscV CPU"
	select SOC_VexRV32
	select ATOMIC_OPERATIONS_C

config BOARD_ORANGECART_VexRV32SMP_FPU
        bool "Board with LiteX/VexRiscV-SMP CPU with FPU"
	select SOC_VexRV32SMP
        select CPU_HAS_FPU_DOUBLE_PRECISION
        select FPU_SHARING
#       select RISCV_ISA_EXT_C
        # ISA EXT C extension seems a bit slower, but more memory efficient, not yet useful on Zephyr
        # however, the bitstream supports it, better for Linux to save memory

config BOARD_ORANGECART_VexRV32SMP_SMP
        bool "Board with LiteX/VexRiscV-SMP dual core CPU"
        select SOC_VexRV32SMP
#       select RISCV_ISA_EXT_C

config BOARD_ORANGECART_VexRV32SMP_IMA
        bool "Board with LiteX/VexRiscV-SMP CPU"
        select SOC_VexRV32SMP
#       select RISCV_ISA_EXT_C
```

## boards/pottendo/orangecart/board.yml
```yaml
board:
  name: orangecart
  vendor: pottendo
  socs:
    - name: VexRV32
    - name: VexRV32SMP
      variants: 
      - name: ima
      - name: fpu
      - name: smp
```

## boards/pottendo/orangecart/orangecart_defconfig
```kconfig
#
# Copyright (c) 2022 pottendo
#
# SPDX-License-Identifier: Apache-2.0
#

CONFIG_SOC_RISCV32_ORANGECART=y
CONFIG_BOARD_ORANGECART=y
CONFIG_CONSOLE=y
CONFIG_SERIAL=y
CONFIG_UART_CONSOLE=y
CONFIG_PRINTK=y
CONFIG_GPIO=n
CONFIG_SPI=y
CONFIG_SDHC=y
CONFIG_XIP=n
CONFIG_CLOCK_CONTROL=n
CONFIG_HEAP_MEM_POOL_SIZE=4096
CONFIG_SYS_CLOCK_HW_CYCLES_PER_SEC=80000000
#CONFIG_SYS_CLOCK_HW_CYCLES_PER_SEC=100000
CONFIG_CPP=y
CONFIG_NEWLIB_LIBC=y
CONFIG_POSIX_API=y
CONFIG_MAX_PTHREAD_COUNT=72
CONFIG_MAX_PTHREAD_MUTEX_COUNT=255
CONFIG_TIMESLICING=y
CONFIG_TIMESLICE_SIZE=10
CONFIG_BOOT_BANNER=y
CONFIG_UART_INTERRUPT_DRIVEN=y
CONFIG_RISCV_PMP=n
CONFIG_C64_MEMBASE=0x00000000
```

## boards/pottendo/orangecart_fpu/Kconfig.defconfig
```kconfig
# Copyright (c) 2023 pottendo
# SPDX-License-Identifier: Apache-2.0

############################################## FPU
if BOARD_ORANGECART_FPU
config BOARD
        default "orangecart_fpu"

config SPI
        default y

config FPU
    bool "Support floating point operations"
        default y

config DISK_DRIVER_SDMMC
        default y if DISK_DRIVERS

config C64_MEMBASE
        hex "memory address, where bitstream maps the C64 64k"
        default 0x0f000000

config RISCV_HAS_PLIC
        default y
        
endif # BOARD_ORANGECART_FPU
```

## boards/pottendo/orangecart_fpu/Kconfig.orangecart_fpu
```kconfig
config BOARD_ORANGECART_FPU
        bool "Board with LiteX/VexRiscV-SMP CPU"
        select SOC_RISCV32_ORANGECART
        select CPU_HAS_FPU_DOUBLE_PRECISION
        select FPU_SHARING
#       select RISCV_ISA_EXT_C
        # ISA EXT C extension seems a bit slower, but more memory efficient, not yet useful on Zephyr
        # however, the bitstream supports it, better for Linux to save memory
```

## boards/pottendo/orangecart_fpu/board.yml
```yaml
board:
  name: orangecart_fpu
  vendor: pottendo
  socs:
    - name: orangecart_riscv32fpu
```

## boards/riscv/orangecart/Kconfig.board
```kconfig
# Copyright (c) 2022-2023 pottendo
# SPDX-License-Identifier: Apache-2.0

config BOARD_ORANGECART
	bool "Board with LiteX/VexRiscV CPU"
	depends on SOC_RISCV32_ORANGECART
	select ATOMIC_OPERATIONS_C

config BOARD_ORANGECART_FPU
	bool "Board with LiteX/VexRiscV-SMP CPU"
	depends on SOC_RISCV32_ORANGECART
	select CPU_HAS_FPU_DOUBLE_PRECISION
	select FPU_SHARING
#	select RISCV_ISA_EXT_C
	# ISA EXT C extension seems a bit slower, but more memory efficient, not yet useful on Zephyr
	# however, the bitstream supports it, better for Linux to save memory

config BOARD_ORANGECART_SMP
	bool "Board with LiteX/VexRiscV-SMP CPU"
	depends on SOC_RISCV32_ORANGECART
#	select RISCV_ISA_EXT_C

config BOARD_ORANGECART2
	bool "Board with LiteX/VexRiscV-SMP CPU"
	depends on SOC_RISCV32_ORANGECART
#	select RISCV_ISA_EXT_C
```

## boards/riscv/orangecart/Kconfig.defconfig
```kconfig
# Copyright (c) 2023 pottendo
# SPDX-License-Identifier: Apache-2.0

############################################## RVCop64 original
if BOARD_ORANGECART

config BOARD
	default "orangecart"

config ARCH_HAS_GDBSTUB
    default n

config SPI
	default y

config FPU
    bool "Support floating point operations"
	default n

config DISK_DRIVER_SDMMC
        default y if DISK_DRIVERS

config C64_MEMBASE
	hex "memory address, where bitstream maps the C64 64k"
	default 0x00000000

endif # BOARD_ORANGECART

############################################## FPU
if BOARD_ORANGECART_FPU
config BOARD
	default "orangecart_fpu"

config SPI
	default y

config FPU
    bool "Support floating point operations"
	default y

config DISK_DRIVER_SDMMC
        default y if DISK_DRIVERS

config C64_MEMBASE
	hex "memory address, where bitstream maps the C64 64k"
	default 0x0f000000

endif # BOARD_ORANGECART_FPU

############################################## SMP
if BOARD_ORANGECART_SMP
config BOARD
	default "orangecart_smp"

config SPI
	default y

config FPU
    bool "Support floating point operations"
	default n

config DISK_DRIVER_SDMMC
        default y if DISK_DRIVERS

config C64_MEMBASE
	hex "memory address, where bitstream maps the C64 64k"
	default 0x0f000000

endif # BOARD_ORANGECART_SMP
```

## boards/riscv/orangecart/orangecart_defconfig
```kconfig
#
# Copyright (c) 2022 pottendo
#
# SPDX-License-Identifier: Apache-2.0
#

CONFIG_SOC_RISCV32_LITEX_VEXRISCV=y
CONFIG_BOARD_ORANGECART=y
CONFIG_CONSOLE=y
CONFIG_SERIAL=y
CONFIG_UART_CONSOLE=y
CONFIG_GPIO=n
CONFIG_SPI=y
CONFIG_SDHC=y
CONFIG_XIP=n
CONFIG_CLOCK_CONTROL=n
CONFIG_HEAP_MEM_POOL_SIZE=4096
CONFIG_SYS_CLOCK_HW_CYCLES_PER_SEC=79000000
CONFIG_TIMESLICING=y
CONFIG_TIMESLICE_SIZE=10
CONFIG_BOOT_BANNER=y
#CONFIG_RISCV_HAS_PLIC=y
#CONFIG_RISCV_HAS_CLIC=y
```

## boards/riscv/orangecart/orangecart_fpu_defconfig
```kconfig
#
# Copyright (c) 2022 pottendo
#
# SPDX-License-Identifier: Apache-2.0
#

CONFIG_SOC_RISCV32_LITEX_VEXRISCV=y
CONFIG_BOARD_ORANGECART_FPU=y
CONFIG_CONSOLE=y
CONFIG_SERIAL=y
CONFIG_UART_CONSOLE=y
CONFIG_GPIO=n
CONFIG_SPI=y
CONFIG_SDHC=y
CONFIG_XIP=n
CONFIG_CLOCK_CONTROL=n
CONFIG_HEAP_MEM_POOL_SIZE=4096
CONFIG_SYS_CLOCK_HW_CYCLES_PER_SEC=80000000   
CONFIG_TIMESLICING=y
CONFIG_TIMESLICE_SIZE=10
CONFIG_CPLUSPLUS=y
CONFIG_LIB_CPLUSPLUS=y
CONFIG_NEWLIB_LIBC=y
CONFIG_PRINTK=y
CONFIG_POSIX_API=y
CONFIG_MAX_PTHREAD_COUNT=72
CONFIG_MAX_PTHREAD_MUTEX_COUNT=255
CONFIG_BOOT_BANNER=y
```

## dts/bindings/pottendo/oc-mailbox.yaml
```yaml
# A YAML binding for orangecart's mailbox device
compatible: "pottendo,oc-mailbox"
description: Orangecart's memory mapped mailbox
include: base.yaml

properties:
  reg:
    required: true

interrupt-cells:
  - irq
  - priority
```

## samples/oc-coproc/sample.yaml
```yaml
sample:
  description: RVCop64 Playground for Zephyr
    application
  name: RVCop64 play
common:
    tags: introduction
    integration_platforms:
      - native_posix
    harness: console
    harness_config:
      type: one_line
      regex:
        - "RVCop64! (.*)"
tests:
  sample.basic.RVCop64:
    tags: introduction
```

## soc/pottendo/VexRV32/Kconfig.defconfig
```kconfig
# Copyright (c) 2023 pottendo
# SPDX-License-Identifier: Apache-2.0

if SOC_VexRV32

config SOC
	default "VexRV32"

config SYS_CLOCK_HW_CYCLES_PER_SEC
	default 80000000

config RISCV_HAS_CPU_IDLE
	bool

config RISCV_HAS_PLIC
	bool

config NUM_IRQS
	default 12

config C64_MEMBASE
	hex
	default 0x00000000

endif 
```

## soc/pottendo/VexRV32SMP/Kconfig.defconfig
```kconfig
# Copyright (c) 2023 pottendo
# SPDX-License-Identifier: Apache-2.0

if SOC_VexRV32SMP

config SOC
	default "VexRV32SMP"

config SYS_CLOCK_HW_CYCLES_PER_SEC
	default 80000000

config RISCV_HAS_CPU_IDLE
	bool

config RISCV_HAS_PLIC
	bool

config NUM_IRQS
	default 12

config C64_MEMBASE
	hex
	default 0x0f000000

endif 
```

## soc/pottendo/VexRV32SMP/Kconfig.soc
```kconfig
# Copyright (c) 2023 pottendo
# SPDX-License-Identifier: Apache-2.0

config SOC_VexRV32SMP
	bool "Orangecart system implementation"
	select RISCV
	select INCLUDE_RESET_VECTOR
	select RISCV_ISA_RV32I
	select RISCV_ISA_EXT_M
	select RISCV_ISA_EXT_A
	select RISCV_ISA_EXT_ZICSR
	select RISCV_ISA_EXT_ZIFENCEI
	select REQUIRES_FULL_LIBCPP
	select SERIAL_SUPPORT_INTERRUPT
	select SERIAL

if SOC_VexRV32SMP

config LITEX_CSR_DATA_WIDTH
	int "Select Control/Status register width"
	default 32

endif # SOC_VexRV32SMP
```

## soc/pottendo/riscv32_orangecart/Kconfig.defconfig
```kconfig
# Copyright (c) 2023 pottendo
# SPDX-License-Identifier: Apache-2.0

if SOC_RISCV32_ORANGECART

config SOC
	default "orangecart_riscv32"

config SYS_CLOCK_HW_CYCLES_PER_SEC
	default 80000000

config RISCV_HAS_CPU_IDLE
	bool

config RISCV_HAS_PLIC
	bool

config NUM_IRQS
	default 12

config C64_MEMBASE
	hex
	default 0x00000000

endif 
```
